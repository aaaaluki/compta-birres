## firmware/main/Kconfig.projbuild
```kconfig
menu "Compta Birres Configuration"
    menu "Display Configuration"
        config CB_DISPLAY_DIGITS
            int "Number of digits on the display"
            default 5
            help
                Number of digits on the display
        config CB_DISPLAY_COMMON_NODE
            int "Common node for the display (CA/CC)"
            default 1
            range 0 1
            help
                "0" for Common Anode, "1" for Common Cathode
        config CB_DISPLAY_PIN_OE
            int "Display OE pin"
            default 21
            help
                GPIO pin to use for the OE pin in the Display
        config CB_DISPLAY_PIN_RCLK
            int "Display RCLK pin"
            default 26
            help
                GPIO pin to use for the RCLK pin in the Display
        config CB_DISPLAY_PIN_SRCLR
            int "Display SRCLR pin"
            default 25
            help
                GPIO pin to use for the SRCLR pin in the Display
        config CB_DISPLAY_PIN_SRCLK
            int "Display SRCLK pin"
            default 22
            help
                GPIO pin to use for the SRCLK pin in the Display
        config CB_DISPLAY_PIN_SER
            int "Display SER pin"
            default 27
            help
                GPIO pin to use for the SER pin in the Display
    endmenu

    menu "Buttons Configuration"
        config CB_BUTTONS_PIN_BUT
            int "Buttons input pin"
            default 34
            help
                GPIO pin to use for the buttons input
        config CB_BUTTONS_PIN_SEL0
            int "CD4051 SEL0 pin"
            default 4
            help
                GPIO pint to use as output for controlling the SEL0 pin of the CD4051 IC
        config CB_BUTTONS_PIN_SEL1
            int "CD4051 SEL1 pin"
            default 16
            help
                GPIO pint to use as output for controlling the SEL1 pin of the CD4051 IC
        config CB_BUTTONS_PIN_SEL2
            int "CD4051 SEL2 pin"
            default 17
            help
                GPIO pint to use as output for controlling the SEL2 pin of the CD4051 IC
        config CB_BUTTONS_PIN_BUT_LOGIC
            int "Logic for the input button"
            default 1
            range 0 1
            help
                "0" for active high logic, "1" for active low logic
    endmenu

    menu "SD Card Configuration"
        config CB_SDCARD_PIN_MOSI
            int "SD Card MOSI pin"
            default 23
            help
                GPIO Pin to use for the MOSI pin in the SD Card
        config CB_SDCARD_PIN_MISO
            int "SD Card MISO pin"
            default 19
            help
                GPIO Pin to use for the MISO pin in the SD Card
        config CB_SDCARD_PIN_CLK
            int "SD Card CLK pin"
            default 18
            help
                GPIO Pin to use for the CLK pin in the SD Card
        config CB_SDCARD_PIN_CS
            int "SD Card CS pin"
            default 5
            help
                GPIO Pin to use for the CS pin in the SD Card
    endmenu

    choice CB_MODE_CHOICE
        prompt "Sample mode to use"
        default CB_MODE_MASTER

        config CB_MODE_MASTER
            bool "MASTER: Run the full compta birres"
        config CB_MODE_DISPLAY_ROTATE_NUMBERS
            bool "DISPLAY: Display rotate numbers"
        config CB_MODE_ICCD4051_ROTATION
            bool "CD4051: Get each output rotation"
        config CB_MODE_ICCD4051_FIXED
            bool "CD4051: Get only one output continuously"
        config CB_MODE_BUTTON_SINGLE
            bool "BUTTON: Display the state of one pin"
        config CB_MODE_COUNTER_BUTTON
            bool "BUTTON: Use one button as a counter"
        config CB_MODE_MUX_BUTTONS
            bool "BUTTON: Run multiple buttons with one 4051"
        config CB_MODE_SDCARD_EXAMPLE
            bool "SD CARD: Mount the uSD card and read it's contents"
    endchoice
    config CB_SAMPLE_MODE
        string
        default "MASTER: Run the full compta birres" if CB_MODE_MASTER
        default "DISPLAY: Display rotate numbers" if CB_MODE_DISPLAY_ROTATE_NUMBERS
        default "CD4051: Get each output rotation" if CB_MODE_ICCD4051_ROTATION
        default "CD4051: Get only one output continuously" if CB_MODE_ICCD4051_FIXED
        default "BUTTON: Display the state of one pin" if CB_MODE_BUTTON_SINGLE
        default "BUTTON: Use one button as a counter" if CB_MODE_COUNTER_BUTTON
        default "BUTTON: Run multiple buttons with one 4051" if CB_MODE_MUX_BUTTONS
        default "SD CARD: Mount the uSD card and read it's contents" if CB_MODE_SDCARD_EXAMPLE

endmenu
```
